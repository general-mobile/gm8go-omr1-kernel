## drivers/misc/mediatek/sensors-1.0/alsps/touch_ps/Kconfig
```kconfig
config MTK_TOUCH_PS
	bool "MTK_TOUCH_PS for MediaTek package"
	default n
	help
	It support different type sensor
	in this platform. If this option
	is set, it will support ambient
	and light sensor MTK_TOUCH_PS.
```
